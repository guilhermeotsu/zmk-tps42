## boards/shields/tps42_sharp_lcd_adapter/Kconfig.shield
```kconfig
# Copyright (c) 2022 The ZMK Contributors
# SPDX-License-Identifier: MIT

config SHIELD_TPS42_SHARP_LCD_ADAPTER
    def_bool $(shields_list_contains,tps42_sharp_lcd_adapter)
```

## config/west.yml
```yaml
manifest:
  remotes:
    - name: zmkfirmware
      url-base: https://github.com/zmkfirmware
    - name: crehmann
      url-base: https://github.com/crehmann
    - name: hunterwei
      url-base: https://github.com/hunterwei
  projects:
    - name: zmk
      remote: hunterwei
      revision: tps42_wip
      import: app/west.yml
  self:
    path: config
```
